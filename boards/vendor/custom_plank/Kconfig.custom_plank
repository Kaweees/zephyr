## west.yml
```yaml
manifest:
  self:
    path: .
    west-commands: scripts/west-commands.yml

  remotes:
    - name: zephyrproject-rtos
      url-base: https://github.com/zephyrproject-rtos

  projects:
    - name: zephyr
      path: zephyr-rtos
      remote: zephyrproject-rtos
      revision: v4.3.0
      clone-depth: 1
      import:
        path-prefix: external
        # By using name-allowlist we can clone only the modules that are
        # strictly needed by the application.
        name-allowlist:
          - cmsis_6    # required by the ARM port for Cortex-M
          - hal_nordic # required by the custom_plank board (Nordic based)
          - hal_stm32  # required by the nucleo_f302r8 board (STM32 based)
```
